## Kconfig
```kconfig
menu "Github OTA Configuration"

    config MAX_FILENAME_LEN
        int "The Max Size Of Filenames"
        default 64
        help
            The Maximum Size of Filenames stored at the Repository

    config MAX_URL_LEN
        int "The Max Size Of URLs"
        default 128
        help
            The Maximum Size of URl's to download Firmware Files
    
    config GITHUB_HOSTNAME
        string "The Hostname of the Github Repository"
        default "api.github.com"
        help
            The Hostname of the Github API Server

    config GITHUB_OWNER
        string "The Owner of the Github Repository"
        default "Fishwaldo"
        help
            The Owner of the Github Repository

    config GITHUB_REPO
        string "The Repository of the Github Repository"
        default "esp_ghota"
        help
            The Repository of the Github Repository

endmenu
```

## examples/esp_ghota_example/sdkconfig.defaults
```kconfig
CONFIG_GITHUB_OWNER="Fishwaldo"
CONFIG_GITHUB_REPO="esp_ghota"
CONFIG_PARTITION_TABLE_CUSTOM=y
CONFIG_PARTITION_TABLE_CUSTOM_FILENAME="partitions.csv"
CONFIG_PARTITION_TABLE_FILENAME="partitions.csv"
CONFIG_ESPTOOLPY_FLASHSIZE_4MB=y
CONFIG_ESP_MAIN_TASK_STACK_SIZE=8192
```
